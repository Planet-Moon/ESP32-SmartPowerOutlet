## main/Kconfig.projbuild
```kconfig
menu "Smart Power Outlet Configuration"

    orsource "$IDF_PATH/examples/common_components/env_caps/$IDF_TARGET/Kconfig.env_caps"

    config SPO_NTC_ENABLE
        bool "enable ntc temperature sensor"
        default n
        help
            use ntc to measure ambient temperature

    config BROKER_URL
        string "Broker URL"
        default "mqtt://mqtt.eclipseprojects.io"
        help
            URL of the broker to connect to

endmenu
```
